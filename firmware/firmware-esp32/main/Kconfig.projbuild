## firmware/firmware-esp32/main/Kconfig.projbuild
```kconfig
menu "Monitor Energetico"

config MONITOR_WIFI_SSID
    string "Wi-Fi SSID"
    default "SEU_SSID"
    help
        SSID da rede Wi-Fi usada pelo ESP32 para conectar ao backend.

config MONITOR_WIFI_PASS
    string "Wi-Fi Password"
    default "SUA_SENHA"
    help
        Senha da rede Wi-Fi usada pelo ESP32.

config MONITOR_FLASK_ENDPOINT_URL
    string "Flask endpoint URL"
    default "https://energia.example.invalid/telemetria"
    help
        URL completa do endpoint HTTP que recebe a telemetria.

config MONITOR_API_TOKEN
    string "Telemetry API token (X-API-Key)"
    default ""
    help
        Use o mesmo valor de API_SECURITY_TOKEN do backend Flask.
        Configure no sdkconfig local; nao publique o segredo no repositorio.

config MONITOR_OTA_URL
    string "OTA firmware URL"
    default "https://energia.example.invalid/firmware/firmware.bin"

config MONITOR_OTA_INTERVAL_SECONDS
    int "Intervalo entre verificacoes OTA (segundos)"
    range 30 86400
    default 3600

endmenu
```

## firmware/firmware-esp32/sdkconfig.defaults
```kconfig
CONFIG_IDF_TARGET="esp32s3"
CONFIG_ESPTOOLPY_FLASHSIZE_4MB=y
CONFIG_PARTITION_TABLE_CUSTOM=y
CONFIG_PARTITION_TABLE_CUSTOM_FILENAME="partitions.csv"
CONFIG_ESP_WIFI_TASK_PINNED_TO_CORE_0=y
CONFIG_LWIP_TCPIP_TASK_AFFINITY_CPU0=y
CONFIG_BOOTLOADER_APP_ROLLBACK_ENABLE=y
CONFIG_ESP_TASK_WDT_PANIC=y
CONFIG_ADC_CONTINUOUS_ISR_IRAM_SAFE=y
CONFIG_MBEDTLS_CERTIFICATE_BUNDLE=y
CONFIG_MBEDTLS_CERTIFICATE_BUNDLE_DEFAULT_FULL=y
```
